## components/pn532_hal/Kconfig
```kconfig
menu "PN532 Configuration"

menu "SPI"

  config PN532_SCK
      int "PN532 SCK GPIO"
    range 0 64
    default 18 if IDF_TARGET_ESP32
    default 21 if IDF_TARGET_ESP32C6
    default 4 if IDF_TARGET_ESP32C3
    default 12 if IDF_TARGET_ESP32S3
    help
      GPIO number (IOxx) for SPI clock.

  config PN532_SS
      int "PN532 SS GPIO"
    range 0 64
    default 5 if IDF_TARGET_ESP32
    default 18 if IDF_TARGET_ESP32C6
    default 7 if IDF_TARGET_ESP32C3
    default 10 if IDF_TARGET_ESP32S3
    help
      GPIO number (IOxx) for SPI slave select.

  config PN532_MISO
      int "PN532 MISO GPIO"
    range 0 64
    default 19 if IDF_TARGET_ESP32
    default 20 if IDF_TARGET_ESP32C6
    default 5 if IDF_TARGET_ESP32C3
    default 13 if IDF_TARGET_ESP32S3
    help
      GPIO number (IOxx) for SPI MISO.

  config PN532_MOSI
      int "PN532 MOSI GPIO"
    range 0 64
    default 23 if IDF_TARGET_ESP32
    default 19 if IDF_TARGET_ESP32C6
    default 6 if IDF_TARGET_ESP32C3
    default 11 if IDF_TARGET_ESP32S3
    help
      GPIO number (IOxx) for SPI MOSI.

endmenu # SPI

config PN532_IRQ
    int "PN532 IRQ GPIO"
  range -1 46
  default -1
  help
    GPIO number (IOxx) for IRQ signal.

endmenu
```

## main/Kconfig.projbuild
```kconfig
menu "Matter Lock HomeKey"

config HOMEKEY_FACTORY_ISSUER_PUBKEY_HEX
    string "Factory issuer Ed25519 public key (hex)"
    default ""
    help
        Optional 32-byte Ed25519 issuer public key encoded as 64 hex characters.
        When set, the main ota_0 runtime seeds this issuer into the shared
        Home Key reader-data NVS model during boot.

        This allows the temporary ota_1 HomeKit provisioner to accept Apple's
        device-credential enrollment requests later, because those requests
        only carry an issuer identifier and not the issuer public key.

endmenu
```

## provisioner/main/Kconfig.projbuild
```kconfig
menu "Home Key Provisioner"

config HOMEKEY_FACTORY_ISSUER_PUBKEY_HEX
    string "Factory issuer Ed25519 public key (hex)"
    default ""
    help
        Optional 32-byte Ed25519 issuer public key encoded as 64 hex characters.
        When set, the ota_1 Home Key provisioner will automatically seed this
        issuer into shared reader data before Apple Home starts endpoint
        enrollment over the HomeKit NFCAccess service.

        This is required because Apple's device-credential enrollment TLVs only
        carry an issuer identifier, not the issuer public key itself.

endmenu
```

## provisioner/sdkconfig.defaults
```kconfig
CONFIG_IDF_TARGET="esp32c6"
CONFIG_ESPTOOLPY_FLASHSIZE_4MB=y
CONFIG_PARTITION_TABLE_SINGLE_APP=n
CONFIG_PARTITION_TABLE_SINGLE_APP_LARGE=n
CONFIG_PARTITION_TABLE_CUSTOM=y
CONFIG_PARTITION_TABLE_CUSTOM_FILENAME="partitions.csv"
CONFIG_PARTITION_TABLE_OFFSET=0xC000
CONFIG_FREERTOS_HZ=1000
CONFIG_LWIP_IPV4=y
CONFIG_AUTOSTART_ARDUINO=y
CONFIG_ARDUINO_SELECTIVE_COMPILATION=y
CONFIG_ARDUINO_SELECTIVE_SPI=n
CONFIG_ARDUINO_SELECTIVE_Wire=n
CONFIG_ARDUINO_SELECTIVE_ESP_SR=n
CONFIG_ARDUINO_SELECTIVE_EEPROM=n
CONFIG_ARDUINO_SELECTIVE_Preferences=n
CONFIG_ARDUINO_SELECTIVE_Ticker=n
CONFIG_ARDUINO_SELECTIVE_Zigbee=n
CONFIG_ARDUINO_SELECTIVE_FS=n
CONFIG_ARDUINO_SELECTIVE_Ethernet=y
CONFIG_ARDUINO_SELECTIVE_SPI=y
CONFIG_ARDUINO_SELECTIVE_PPP=n
CONFIG_ARDUINO_SELECTIVE_Network=y
CONFIG_ARDUINO_SELECTIVE_Hash=y
CONFIG_ARDUINO_SELECTIVE_WiFi=y
CONFIG_ARDUINO_SELECTIVE_AsyncUDP=y
CONFIG_ARDUINO_SELECTIVE_DNSServer=y
CONFIG_ARDUINO_SELECTIVE_ESPmDNS=y
CONFIG_ARDUINO_SELECTIVE_ArduinoOTA=y
CONFIG_ARDUINO_SELECTIVE_HTTPClient=n
CONFIG_ARDUINO_SELECTIVE_Matter=n
CONFIG_ARDUINO_SELECTIVE_NetBIOS=n
CONFIG_ARDUINO_SELECTIVE_WebServer=n
CONFIG_ARDUINO_SELECTIVE_NetworkClientSecure=n
CONFIG_ARDUINO_SELECTIVE_WiFiProv=n
CONFIG_ARDUINO_SELECTIVE_BLE=n
CONFIG_ARDUINO_SELECTIVE_BluetoothSerial=n
CONFIG_ARDUINO_SELECTIVE_SimpleBLE=n
CONFIG_ARDUINO_SELECTIVE_RainMaker=n
CONFIG_ARDUINO_SELECTIVE_OpenThread=n
CONFIG_ARDUINO_SELECTIVE_Insights=n
CONFIG_APP_COMPATIBLE_PRE_V3_1_BOOTLOADERS=y
CONFIG_PARTITION_TABLE_MD5=n
```

## sdkconfig.defaults.esp32c3
```kconfig
CONFIG_IDF_TARGET="esp32c3"

# ESP32-C3-DevKitC-02 Settings
# Buttons
CONFIG_BSP_BUTTONS_NUM=1
CONFIG_BSP_BUTTON_1_TYPE_GPIO=y
CONFIG_BSP_BUTTON_1_GPIO=9
CONFIG_BSP_BUTTON_1_LEVEL=0
# LEDs
CONFIG_BSP_LEDS_NUM=1
CONFIG_BSP_LED_TYPE_RGB=y
CONFIG_BSP_LED_RGB_GPIO=8
CONFIG_BSP_LED_RGB_BACKEND_RMT=y

# Memory optimization for ESP32-C3
CONFIG_ESP_WIFI_STATIC_RX_BUFFER_NUM=4
CONFIG_ESP_WIFI_DYNAMIC_RX_BUFFER_NUM=16
CONFIG_ESP_WIFI_DYNAMIC_TX_BUFFER_NUM=16
CONFIG_ESP_WIFI_TX_BA_WIN=6
CONFIG_ESP_WIFI_RX_BA_WIN=6
CONFIG_ESP_WIFI_MGMT_SBUF_NUM=16
CONFIG_MBEDTLS_DYNAMIC_BUFFER=y
```
